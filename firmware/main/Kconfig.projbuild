## firmware/main/Kconfig.projbuild
```kconfig
menu "Beaver controller"

config BB_CONTROLLER_ID
    int "Controller ID (unique per controller)"
    range 1 3
    default 1

config BB_WIFI_SSID
    string "Wi-Fi SSID (2.4 GHz)"
    default ""

config BB_WIFI_PASSWORD
    string "Wi-Fi password (empty for open network)"
    default ""

config BB_LAPTOP_IP
    string "Laptop IPv4 address"
    default "192.168.1.2"

config BB_LAPTOP_PORT
    int "Laptop UDP port"
    range 1 65535
    default 4210

config BB_LASER_DUTY
    int "Laser on duty (10-bit, external gate driver required)"
    range 1 1023
    default 1023

config BB_LASER_BUTTON_TEST
    bool "Laser button bench test (no Wi-Fi)"
    default n
    help
        Hold FIRE for steady laser output, SPECIAL for 2 Hz flashing (250 ms
        on, 250 ms off). SPECIAL wins if both are held. Release both for off.
        Disable this option and rebuild to restore game operation.
        Enable Servo button bench test too for simultaneous servo jogging.

config BB_FIRE_GPIO
    int "FIRE / steady laser button GPIO"
    range 0 33
    default 27

config BB_SPECIAL_GPIO
    int "SPECIAL / pulsing laser button GPIO"
    range 0 33
    default 32

config BB_SERVO_ENABLED
    bool "Enable calibrated servo output"
    depends on !BB_LASER_BUTTON_TEST && !BB_SERVO_BUTTON_TEST
    default n
    help
        Leave disabled until rest/press pulse widths and mechanical travel are
        calibrated. When disabled GPIO33 stays low and no servo pulse is sent.

config BB_SERVO_BUTTON_TEST
    bool "Servo button bench test (no Wi-Fi)"
    default n
    help
        Start at 1500 us. Hold FIRE to lower the pulse or SPECIAL to raise it.
        Neither or both buttons hold the current position. Disable this option
        and rebuild to restore game operation.
        Laser stays off unless Laser button bench test is also enabled.

config BB_SERVO_TEST_MIN_US
    int "Servo bench minimum pulse (microseconds)"
    depends on BB_SERVO_BUTTON_TEST
    range 500 1500
    default 1200

config BB_SERVO_TEST_MAX_US
    int "Servo bench maximum pulse (microseconds)"
    depends on BB_SERVO_BUTTON_TEST
    range 1500 2500
    default 1800

config BB_SERVO_TEST_STEP_US
    int "Servo bench pulse step per 20 ms (microseconds)"
    depends on BB_SERVO_BUTTON_TEST
    range 1 100
    default 5

config BB_SERVO_REST_US
    int "Servo rest pulse width (microseconds)"
    range 500 2500
    default 1500

config BB_SERVO_PRESS_US
    int "Servo press pulse width (microseconds)"
    range 500 2500
    default 1600

endmenu
```

## firmware/sdkconfig.defaults
```kconfig
CONFIG_FREERTOS_HZ=1000
CONFIG_ESP_MAIN_TASK_STACK_SIZE=6144
CONFIG_ESPTOOLPY_FLASHSIZE_4MB=y
CONFIG_BB_CONTROLLER_ID=1
CONFIG_BB_WIFI_SSID=""
CONFIG_BB_WIFI_PASSWORD=""
CONFIG_BB_LAPTOP_IP="192.168.1.2"
CONFIG_BB_LAPTOP_PORT=4210
CONFIG_BB_SERVO_ENABLED=n
CONFIG_BB_SERVO_REST_US=990
CONFIG_BB_SERVO_PRESS_US=570
CONFIG_BB_LASER_DUTY=1023
```
